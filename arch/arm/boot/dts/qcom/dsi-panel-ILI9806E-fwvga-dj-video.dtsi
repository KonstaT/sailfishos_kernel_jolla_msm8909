/**********uniscope-driver-modify-file-on-qualcomm-platform*****************/
/* Copyright (c) 2013, The Linux Foundation. All rights reserved.
 *
 * This program is free software; you can redistribute it and/or modify
 * it under the terms of the GNU General Public License version 2 and
 * only version 2 as published by the Free Software Foundation.
 *
 * This program is distributed in the hope that it will be useful,
 * but WITHOUT ANY WARRANTY; without even the implied warranty of
 * MERCHANTABILITY or FITNESS FOR A PARTICULAR PURPOSE.  See the
 * GNU General Public License for more details.
 */

/*---------------------------------------------------------------------------
 * This file is autogenerated file using gcdb parser. Please do not edit it.
 * Update input XML file to add a new entry or update variable in this file
 * VERSION = "1.0"
 *---------------------------------------------------------------------------*/
&mdss_mdp {
	dsi_ili9806e_fwvga_dj_video: qcom,mdss_dsi_ili9806e_fwvga_dj_video {
		qcom,mdss-dsi-panel-name = "ILI9806E fwvga dj video mode dsi panel";
		qcom,mdss-dsi-panel-controller = <&mdss_dsi0>;
		qcom,mdss-dsi-panel-type = "dsi_video_mode";
		qcom,mdss-dsi-panel-destination = "display_1";
		qcom,mdss-dsi-panel-framerate = <60>;
		qcom,mdss-dsi-virtual-channel-id = <0>;
		qcom,mdss-dsi-stream = <0>;
		qcom,mdss-dsi-panel-width = <480>;
		qcom,mdss-dsi-panel-height = <854>;
		qcom,mdss-dsi-h-front-porch = <40>;
		qcom,mdss-dsi-h-back-porch = <40>;
		qcom,mdss-dsi-h-pulse-width = <40>;
		qcom,mdss-dsi-h-sync-skew = <0>;
		qcom,mdss-dsi-v-back-porch = <20>;
		qcom,mdss-dsi-v-front-porch = <20>;
		qcom,mdss-dsi-v-pulse-width = <10>;
		qcom,mdss-dsi-h-left-border = <0>;
		qcom,mdss-dsi-h-right-border = <0>;
		qcom,mdss-dsi-v-top-border = <0>;
		qcom,mdss-dsi-v-bottom-border = <0>;
		qcom,mdss-dsi-bpp = <24>;
		qcom,mdss-dsi-color-order = "rgb_swap_rgb";
		qcom,mdss-dsi-underflow-color = <0xff>;
		qcom,mdss-dsi-border-color = <0>;
		qcom,mdss-dsi-on-command = [29 01 00 00 00 00 06 FF FF 98 06 04 01
			29 01 00 00 00 00 02 08 10
			29 01 00 00 00 00 02 21 01
			29 01 00 00 00 00 02 30 01
			29 01 00 00 00 00 02 31 02
			29 01 00 00 00 00 02 40 15
			29 01 00 00 00 00 02 41 44
			29 01 00 00 00 00 02 42 01
			29 01 00 00 00 00 02 43 09
			29 01 00 00 00 00 02 44 09
			29 01 00 00 00 00 02 50 78
			29 01 00 00 00 00 02 51 78
			29 01 00 00 00 00 02 52 00
			29 01 00 00 00 00 02 53 71
			29 01 00 00 00 00 02 60 07
			29 01 00 00 00 00 02 61 00
			29 01 00 00 00 00 02 62 07
			29 01 00 00 00 00 02 63 00
			29 01 00 00 00 00 02 57 50
			29 01 00 00 00 00 02 A0 00
			29 01 00 00 00 00 02 A1 0A
			29 01 00 00 00 00 02 A2 0F
			29 01 00 00 00 00 02 A3 0D
			29 01 00 00 00 00 02 A4 06
			29 01 00 00 00 00 02 A5 0B
			29 01 00 00 00 00 02 A6 07
			29 01 00 00 00 00 02 A7 06
			29 01 00 00 00 00 02 A8 06
			29 01 00 00 00 00 02 A9 0A
			29 01 00 00 00 00 02 AA 0E
			29 01 00 00 00 00 02 AB 05 
			29 01 00 00 00 00 02 AC 0A
			29 01 00 00 00 00 02 AD 24
			29 01 00 00 00 00 02 AE 20
			29 01 00 00 00 00 02 AF 00
			29 01 00 00 00 00 02 C0 00
			29 01 00 00 00 00 02 C1 0A
			29 01 00 00 00 00 02 C2 0F
			29 01 00 00 00 00 02 C3 0D
			29 01 00 00 00 00 02 C4 06
			29 01 00 00 00 00 02 C5 0B
			29 01 00 00 00 00 02 C6 07
			29 01 00 00 00 00 02 C7 06
			29 01 00 00 00 00 02 C8 06
			29 01 00 00 00 00 02 C9 0A
			29 01 00 00 00 00 02 CA 0E
			29 01 00 00 00 00 02 CB 05
			29 01 00 00 00 00 02 CC 0A
			29 01 00 00 00 00 02 CD 24
			29 01 00 00 00 00 02 CE 20
			29 01 00 00 00 00 02 CF 00
			29 01 00 00 00 00 06 FF FF 98 06 04 06
			29 01 00 00 00 00 02 00 23
			29 01 00 00 00 00 02 01 0A
			29 01 00 00 00 00 02 02 00
			29 01 00 00 00 00 02 03 04
			29 01 00 00 00 00 02 04 01
			29 01 00 00 00 00 02 05 01
			29 01 00 00 00 00 02 06 80
			29 01 00 00 00 00 02 07 08
			29 01 00 00 00 00 02 08 09
			29 01 00 00 00 00 02 09 00
			29 01 00 00 00 00 02 0A 00
			29 01 00 00 00 00 02 0B 00
			29 01 00 00 00 00 02 0C 01
			29 01 00 00 00 00 02 0D 01
			29 01 00 00 00 00 02 0E 00
			29 01 00 00 00 00 02 0F 00
			29 01 00 00 00 00 02 10 7E
			29 01 00 00 00 00 02 11 F3
			29 01 00 00 00 00 02 12 04
			29 01 00 00 00 00 02 13 00
			29 01 00 00 00 00 02 14 00
			29 01 00 00 00 00 02 15 C0
			29 01 00 00 00 00 02 16 08
			29 01 00 00 00 00 02 17 00
			29 01 00 00 00 00 02 18 00
			29 01 00 00 00 00 02 19 00
			29 01 00 00 00 00 02 1A 00
			29 01 00 00 00 00 02 1B 00
			29 01 00 00 00 00 02 1C 00
			29 01 00 00 00 00 02 1D 00
			29 01 00 00 00 00 02 20 01
			29 01 00 00 00 00 02 21 23
			29 01 00 00 00 00 02 22 45
			29 01 00 00 00 00 02 23 67
			29 01 00 00 00 00 02 24 01
			29 01 00 00 00 00 02 25 23
			29 01 00 00 00 00 02 26 45
			29 01 00 00 00 00 02 27 67
			29 01 00 00 00 00 02 30 01
			29 01 00 00 00 00 02 31 86
			29 01 00 00 00 00 02 32 AA
			29 01 00 00 00 00 02 33 DB
			29 01 00 00 00 00 02 34 CC
			29 01 00 00 00 00 02 35 BD
			29 01 00 00 00 00 02 36 EE
			29 01 00 00 00 00 02 37 FF
			29 01 00 00 00 00 02 38 22
			29 01 00 00 00 00 02 39 22
			29 01 00 00 00 00 02 3A 99
			29 01 00 00 00 00 02 3B 68
			29 01 00 00 00 00 02 3C 22
			29 01 00 00 00 00 02 3D 22
			29 01 00 00 00 00 02 3E 22
			29 01 00 00 00 00 02 3F 22
			29 01 00 00 00 00 02 40 22
			29 01 00 00 00 00 02 52 10
			29 01 00 00 00 00 02 53 10
			29 01 00 00 00 00 02 54 13
			29 01 00 00 00 00 06 FF FF 98 06 04 07
			29 01 00 00 00 00 02 17 22
			29 01 00 00 00 00 02 02 77
			29 01 00 00 00 00 02 E1 79
			29 01 00 00 00 00 02 B3 10
			29 01 00 00 00 00 02 06 13
			29 01 00 00 00 00 06 FF FF 98 06 04 00
			29 01 00 00 32 00 02 11 00
			29 01 00 00 78 00 02 29 00];
		qcom,mdss-dsi-off-command = [05 01 00 00 32 00 02 28 00
					05 01 00 00 78 00 02 10 00];
		qcom,mdss-dsi-on-command-state = "dsi_lp_mode";
		qcom,mdss-dsi-off-command-state = "dsi_lp_mode";
		qcom,mdss-dsi-h-sync-pulse = <1>;
		qcom,mdss-dsi-traffic-mode = "burst_mode";
		qcom,mdss-dsi-lane-map = "lane_map_0123";
		qcom,mdss-dsi-bllp-eof-power-mode;
		qcom,mdss-dsi-bllp-power-mode;
		qcom,mdss-dsi-lane-0-state;
		qcom,mdss-dsi-lane-1-state;
		//qcom,mdss-dsi-lane-2-state;
		//qcom,mdss-dsi-lane-3-state;
		qcom,mdss-dsi-panel-timings = [86 18 10 00 3a 3e 14 1c 12 03 04 00];
		qcom,mdss-dsi-t-clk-post = <0x04>;
		qcom,mdss-dsi-t-clk-pre = <0x27>;
		qcom,mdss-dsi-bl-min-level = <1>;
		qcom,mdss-dsi-bl-max-level = <4095>;
		qcom,mdss-dsi-bl-pmic-control-type = "bl_ctrl_pwm";
		qcom,mdss-dsi-bl-pmic-pwm-frequency = <100>;
		qcom,mdss-dsi-bl-pmic-bank-select = <0>;
		qcom,mdss-dsi-pwm-gpio = <&pm8909_mpps 2 0>;
		qcom,mdss-dsi-dma-trigger = "trigger_sw";
		qcom,mdss-dsi-mdp-trigger = "none";
		//qcom,mdss-dsi-bl-pmic-control-type = "bl_ctrl_wled";
		qcom,mdss-dsi-reset-sequence = <1 20>, <0 2>, <1 120>;
	};
};
