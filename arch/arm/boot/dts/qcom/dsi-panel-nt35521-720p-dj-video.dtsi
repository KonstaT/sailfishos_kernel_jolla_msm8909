/**********uniscope-driver-modify-file-on-qualcomm-platform*****************/
/* Copyright (c) 2013, The Linux Foundation. All rights reserved.
 *
 * This program is free software; you can redistribute it and/or modify
 * it under the terms of the GNU General Public License version 2 and
 * only version 2 as published by the Free Software Foundation.
 *
 * This program is distributed in the hope that it will be useful,
 * but WITHOUT ANY WARRANTY; without even the implied warranty of
 * MERCHANTABILITY or FITNESS FOR A PARTICULAR PURPOSE.  See the
 * GNU General Public License for more details.
 */

/*---------------------------------------------------------------------------
 * This file is autogenerated file using gcdb parser. Please do not edit it.
 * Update input XML file to add a new entry or update variable in this file
 * VERSION = "1.0"
 *---------------------------------------------------------------------------*/
&mdss_mdp {
	dsi_nt35521_720p_dj_video: qcom,mdss_dsi_nt35521_720p_dj_video {
		qcom,mdss-dsi-panel-name = "nt35521 720p dj video mode dsi panel";
		qcom,mdss-dsi-panel-controller = <&mdss_dsi0>;
		qcom,mdss-dsi-panel-type = "dsi_video_mode";
		qcom,mdss-dsi-panel-destination = "display_1";
		qcom,mdss-dsi-panel-framerate = <60>;
		qcom,mdss-dsi-virtual-channel-id = <0>;
		qcom,mdss-dsi-stream = <0>;
		qcom,mdss-dsi-panel-width = <720>;
		qcom,mdss-dsi-panel-height = <1280>;
		qcom,mdss-dsi-h-front-porch = <80>;//32
		qcom,mdss-dsi-h-back-porch = <80>;//32
		qcom,mdss-dsi-h-pulse-width = <10>;//8
		qcom,mdss-dsi-h-sync-skew = <0>;
		qcom,mdss-dsi-v-back-porch = <20>;//18
		qcom,mdss-dsi-v-front-porch = <20>;
		qcom,mdss-dsi-v-pulse-width = <10>;
		qcom,mdss-dsi-h-left-border = <0>;
		qcom,mdss-dsi-h-right-border = <0>;
		qcom,mdss-dsi-v-top-border = <0>;
		qcom,mdss-dsi-v-bottom-border = <0>;
		qcom,mdss-dsi-bpp = <24>;
		qcom,mdss-dsi-color-order = "rgb_swap_rgb";
		qcom,mdss-dsi-underflow-color = <0xff>;
		qcom,mdss-dsi-border-color = <0>;
		qcom,mdss-dsi-on-command = [29 01 00 00 00 00 05 FF AA 55 A5 80
			29 01 00 00 00 00 03 6F 11 00
			29 01 00 00 00 00 03 F7 20 00
			29 01 00 00 00 00 02 6F 06
			29 01 00 00 00 00 02 F7 A0
			29 01 00 00 00 00 02 6F 19
			29 01 00 00 00 00 02 F7 12
			29 01 00 00 00 00 02 6F 02
			29 01 00 00 00 00 02 F7 47
			29 01 00 00 00 00 02 6F 17
			29 01 00 00 00 00 02 F4 70
			29 01 00 00 00 00 02 6F 01
			29 01 00 00 00 00 02 F9 46
			29 01 00 00 00 00 06 F0 55 AA 52 08 00
			29 01 00 00 00 00 06 BD 01 A0 10 10 01
			29 01 00 00 00 00 05 B8 01 02 0C 02
			29 01 00 00 00 00 03 BB 11 11
			29 01 00 00 00 00 03 BC 00 00
			29 01 00 00 00 00 02 B6 08
			29 01 00 00 00 00 02 C8 00//80 
			29 01 00 00 00 00 03 D9 01 01
			29 01 00 00 00 00 02 D4 C7
			29 01 00 00 00 00 03 B1 60 21
			29 01 00 00 00 00 06 F0 55 AA 52 08 01
			29 01 00 00 00 00 03 B0 09 09
			29 01 00 00 00 00 03 B1 09 09
			29 01 00 00 00 00 03 BC A0 00
			29 01 00 00 00 00 03 BD A0 00
			29 01 00 00 00 00 02 BE 3F
			29 01 00 00 00 00 02 CA 00
			29 01 00 00 00 00 02 C0 0C
			29 01 00 00 00 00 03 B5 03 03
			29 01 00 00 00 00 03 B3 19 19
			29 01 00 00 00 00 03 B4 19 19
			29 01 00 00 00 00 03 B9 26 26
			29 01 00 00 00 00 03 BA 24 24
			29 01 00 00 00 00 06 F0 55 AA 52 08 02
			29 01 00 00 00 00 02 EE 01
			29 01 00 00 00 00 11 B0 00 00 00 16 00 41 00 62 00 7B 00 94 00 B5 00 E9
			29 01 00 00 00 00 11 B1 01 0F 01 49 01 78 01 C0 01 F8 01 FA 02 2F 02 69
			29 01 00 00 00 00 11 B2 02 8F 02 C2 02 E7 03 16 03 35 03 5E 03 78 03 99
			29 01 00 00 00 00 05 B3 03 DE 03 FF
			29 01 00 00 00 00 02 C0 04
			29 01 00 00 00 00 06 F0 55 AA 52 08 06
			29 01 00 00 00 00 03 B0 31 2E
			29 01 00 00 00 00 03 B1 10 12
			29 01 00 00 00 00 03 B2 16 18
			29 01 00 00 00 00 03 B3 31 31
			29 01 00 00 00 00 03 B4 31 34
			29 01 00 00 00 00 03 B5 34 34
			29 01 00 00 00 00 03 B6 34 34
			29 01 00 00 00 00 03 B7 34 34
			29 01 00 00 00 00 03 B8 33 2D
			29 01 00 00 00 00 03 B9 00 02
			29 01 00 00 00 00 03 BA 03 01
			29 01 00 00 00 00 03 BB 2D 33
			29 01 00 00 00 00 03 BC 34 34
			29 01 00 00 00 00 03 BD 34 34
			29 01 00 00 00 00 03 BE 34 34
			29 01 00 00 00 00 03 BF 34 31
			29 01 00 00 00 00 03 C0 31 31
			29 01 00 00 00 00 03 C1 19 17
			29 01 00 00 00 00 03 C2 13 11
			29 01 00 00 00 00 03 C3 2E 31
			29 01 00 00 00 00 03 E5 31 31
			29 01 00 00 00 00 03 C4 31 2D
			29 01 00 00 00 00 03 C5 19 17
			29 01 00 00 00 00 03 C6 13 11
			29 01 00 00 00 00 03 C7 31 31
			29 01 00 00 00 00 03 C8 31 34
			29 01 00 00 00 00 03 C9 34 34
			29 01 00 00 00 00 03 CA 34 34
			29 01 00 00 00 00 03 CB 34 34
			29 01 00 00 00 00 03 CC 33 2E
			29 01 00 00 00 00 03 CD 03 01
			29 01 00 00 00 00 03 CE 00 02
			29 01 00 00 00 00 03 CF 2E 33
			29 01 00 00 00 00 03 D0 34 34
			29 01 00 00 00 00 03 D1 34 34
			29 01 00 00 00 00 03 D2 34 34
			29 01 00 00 00 00 03 D3 34 31
			29 01 00 00 00 00 03 D4 31 31
			29 01 00 00 00 00 03 D5 10 12
			29 01 00 00 00 00 03 D6 16 18
			29 01 00 00 00 00 03 D7 2D 31
			29 01 00 00 00 00 03 E6 31 31
			29 01 00 00 00 00 06 D8 00 00 00 00 00
			29 01 00 00 00 00 06 D9 00 00 00 00 00
			29 01 00 00 00 00 02 E7 00
			29 01 00 00 00 00 06 F0 55 AA 52 08 05
			29 01 00 00 00 00 02 ED 30
			29 01 00 00 00 00 03 B0 17 06
			29 01 00 00 00 00 02 B8 00
			29 01 00 00 00 00 02 C0 0D
			29 01 00 00 00 00 02 C1 0B
			29 01 00 00 00 00 02 C2 00
			29 01 00 00 00 00 02 C3 00
			29 01 00 00 00 00 02 C4 84
			29 01 00 00 00 00 02 C5 82
			29 01 00 00 00 00 02 C6 82
			29 01 00 00 00 00 02 C7 80
			29 01 00 00 00 00 03 C8 0B 20
			29 01 00 00 00 00 03 C9 07 20
			29 01 00 00 00 00 03 CA 01 10
			29 01 00 00 00 00 03 CB 01 10
			29 01 00 00 00 00 06 D1 03 05 05 07 00
			29 01 00 00 00 00 06 D2 03 05 09 03 00
			29 01 00 00 00 00 06 D3 00 00 6A 07 10
			29 01 00 00 00 00 06 D4 30 00 6A 07 10
			29 01 00 00 00 00 06 F0 55 AA 52 08 03
			29 01 00 00 00 00 03 B0 00 00
			29 01 00 00 00 00 03 B1 00 00
			29 01 00 00 00 00 06 B2 05 00 B8 00 00
			29 01 00 00 00 00 06 B3 05 00 B8 00 00
			29 01 00 00 00 00 06 B4 05 00 B8 00 00
			29 01 00 00 00 00 06 B5 05 00 B8 00 00
			29 01 00 00 00 00 06 B6 02 00 B8 00 00
			29 01 00 00 00 00 06 B7 02 00 B8 00 00
			29 01 00 00 00 00 06 B8 02 00 B8 00 00
			29 01 00 00 00 00 06 B9 02 00 B8 00 00
			29 01 00 00 00 00 06 BA 53 00 B8 00 00
			29 01 00 00 00 00 06 BB 53 00 B8 00 00
			29 01 00 00 00 00 06 BC 53 00 B8 00 00
			29 01 00 00 00 00 06 BD 53 00 B8 00 00
			29 01 00 00 00 00 02 C4 60
			29 01 00 00 00 00 02 C5 40
			29 01 00 00 00 00 02 C6 64
			29 01 00 00 00 00 02 C7 44
			29 01 00 00 00 00 02 6F 11
			29 01 00 00 00 00 02 F3 01
			29 01 00 00 00 00 06 F0 55 AA 52 08 04//
			29 01 00 00 00 00 05 EA 00 00 00 70//
			//29 01 00 00 00 00 03 EF 07 FF//
			29 01 00 00 78 00 02 11 00
			29 01 00 00 32 00 02 29 00
			];  
		qcom,mdss-dsi-off-command = [05 01 00 00 32 00 02 28 00
					05 01 00 00 78 00 02 10 00];
		qcom,mdss-dsi-on-command-state = "dsi_lp_mode";
		qcom,mdss-dsi-off-command-state = "dsi_lp_mode";
		qcom,mdss-dsi-h-sync-pulse = <1>;
		//qcom,mdss-dsi-lp11-init;//
		//qcom,mdss-dsi-lp11-delay-us = <5000>;//
		qcom,mdss-dsi-traffic-mode = "burst_mode";
		qcom,mdss-dsi-lane-map = "lane_map_0123";
		qcom,mdss-dsi-bllp-eof-power-mode;
		qcom,mdss-dsi-bllp-power-mode;
		qcom,mdss-dsi-lane-0-state;
		qcom,mdss-dsi-lane-1-state;
		qcom,mdss-dsi-lane-2-state;
		qcom,mdss-dsi-lane-3-state;
		//qcom,mdss-dsi-panel-timings = [85 18 10 00 3a 3c 14 1a 13 03 04 00];
		qcom,mdss-dsi-panel-timings = [82 1a 12 00 3e 42 16 2f 14 03 04 00];
		qcom,mdss-dsi-t-clk-post = <0x04>;
		qcom,mdss-dsi-t-clk-pre = <0x27>;
		qcom,mdss-dsi-bl-min-level = <1>;
		qcom,mdss-dsi-bl-max-level = <4095>;
		qcom,mdss-dsi-dma-trigger = "trigger_sw";
		qcom,mdss-dsi-mdp-trigger = "none";
		//qcom,mdss-dsi-bl-pmic-control-type = "bl_ctrl_wled";
		qcom,mdss-dsi-bl-pmic-control-type = "bl_ctrl_pwm";
		qcom,mdss-dsi-bl-pmic-pwm-frequency = <100>;
		qcom,mdss-dsi-bl-pmic-bank-select = <0>;
		qcom,mdss-dsi-pwm-gpio = <&pm8909_mpps 2 0>;
		qcom,mdss-dsi-reset-sequence = <1 20>, <0 20>, <1 120>;
	};
};
