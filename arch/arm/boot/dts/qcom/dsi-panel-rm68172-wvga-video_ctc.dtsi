/**********uniscope-driver-modify-file-on-qualcomm-platform*****************/
/* Copyright (c) 2013, The Linux Foundation. All rights reserved.
 *
 * This program is free software; you can redistribute it and/or modify
 * it under the terms of the GNU General Public License version 2 and
 * only version 2 as published by the Free Software Foundation.
 *
 * This program is distributed in the hope that it will be useful,
 * but WITHOUT ANY WARRANTY; without even the implied warranty of
 * MERCHANTABILITY or FITNESS FOR A PARTICULAR PURPOSE.  See the
 * GNU General Public License for more details.
 */

/*---------------------------------------------------------------------------
 * This file is autogenerated file using gcdb parser. Please do not edit it.
 * Update input XML file to add a new entry or update variable in this file
 * VERSION = "1.0"
 *---------------------------------------------------------------------------*/
&mdss_mdp {
	dsi_rm68172_wvga_video_ctc: qcom,mdss_dsi_rm68172_wvga_video_ctc {
		qcom,mdss-dsi-panel-name = "rm68172 wvga video ctc mode dsi panel";
		qcom,mdss-dsi-panel-controller = <&mdss_dsi0>;
		qcom,mdss-dsi-panel-type = "dsi_video_mode";
		qcom,mdss-dsi-panel-destination = "display_1";
		qcom,mdss-dsi-panel-framerate = <60>;
		qcom,mdss-dsi-virtual-channel-id = <0>;
		qcom,mdss-dsi-stream = <0>;
		qcom,mdss-dsi-panel-width = <480>;
		qcom,mdss-dsi-panel-height = <800>;
		/* Modified by JZZ(zhizhang) adjust MIPI frequent to 
		  418MHz for mitigate noise to RF 20141027 begin */
		qcom,mdss-dsi-h-front-porch = <80>;
		qcom,mdss-dsi-h-back-porch = <80>;
		qcom,mdss-dsi-h-pulse-width = <30>;
		qcom,mdss-dsi-h-sync-skew = <0>;
		qcom,mdss-dsi-v-back-porch = <25>;
		qcom,mdss-dsi-v-front-porch = <25>;
		qcom,mdss-dsi-v-pulse-width = <18>;
		/* Modified by JZZ(zhizhang) adjust MIPI frequent to 
		  418MHz for mitigate noise to RF 20141027 begin */
		qcom,mdss-dsi-h-left-border = <0>;
		qcom,mdss-dsi-h-right-border = <0>;
		qcom,mdss-dsi-v-top-border = <0>;
		qcom,mdss-dsi-v-bottom-border = <0>;
		qcom,mdss-dsi-bpp = <24>;
		qcom,mdss-dsi-color-order = "rgb_swap_rgb";
		qcom,mdss-dsi-underflow-color = <0xff>;
		qcom,mdss-dsi-border-color = <0>;
		qcom,mdss-dsi-on-command = [29 01 00 00 00 00 06 F0 55 AA 52 08 02
			29 01 00 00 00 00 03 F6 60 40
			29 01 00 00 00 00 06 F0 55 AA 52 08 01
			29 01 00 00 00 00 04 B0 0F 0F 0F
			29 01 00 00 00 00 04 B1 08 08 08
			29 01 00 00 00 00 04 B5 02 02 02
			29 01 00 00 00 00 04 B6 34 34 34
			29 01 00 00 00 00 04 B7 44 44 44
			29 01 00 00 00 00 04 B8 24 24 24
			29 01 00 00 00 00 04 B9 34 34 34
			29 01 00 00 00 00 04 BA 04 04 04
			29 01 00 00 00 00 04 BC 00 78 00
			29 01 00 00 00 00 04 BD 00 78 00
			29 01 00 00 00 00 03 BE 00 69
			29 01 00 00 00 00 35 D1 00 00 00 02 00 0B 00 1D 00 34 00 6B 00 9E 00 EA 01 1E 01 63 01 92 01 D2 02 02 02 04 02 2E 02 57 02 6E 02 89 02 9A 02 AF 02 BD 02 D0 02 DD 02 F2 03 22 03 FB
			29 01 00 00 00 00 35 D2 00 00 00 02 00 0B 00 1D 00 34 00 6B 00 9E 00 EA 01 1E 01 63 01 92 01 D2 02 02 02 04 02 2E 02 57 02 6E 02 89 02 9A 02 AF 02 BD 02 D0 02 DD 02 F2 03 22 03 FB
			29 01 00 00 00 00 35 D3 00 00 00 02 00 0B 00 1D 00 34 00 6B 00 9E 00 EA 01 1E 01 63 01 92 01 D2 02 02 02 04 02 2E 02 57 02 6E 02 89 02 9A 02 AF 02 BD 02 D0 02 DD 02 F2 03 22 03 FB
			29 01 00 00 00 00 35 D4 00 00 00 02 00 0B 00 1D 00 34 00 6B 00 9E 00 EA 01 1E 01 63 01 92 01 D2 02 02 02 04 02 2E 02 57 02 6E 02 89 02 9A 02 AF 02 BD 02 D0 02 DD 02 F2 03 22 03 FB
			29 01 00 00 00 00 35 D5 00 00 00 02 00 0B 00 1D 00 34 00 6B 00 9E 00 EA 01 1E 01 63 01 92 01 D2 02 02 02 04 02 2E 02 57 02 6E 02 89 02 9A 02 AF 02 BD 02 D0 02 DD 02 F2 03 22 03 FB
			29 01 00 00 00 00 35 D6 00 00 00 02 00 0B 00 1D 00 34 00 6B 00 9E 00 EA 01 1E 01 63 01 92 01 D2 02 02 02 04 02 2E 02 57 02 6E 02 89 02 9A 02 AF 02 BD 02 D0 02 DD 02 F2 03 22 03 FB
			29 01 00 00 00 00 06 F0 55 AA 52 08 03
			29 01 00 00 00 00 08 B0 03 17 F9 24 53 00 30
			29 01 00 00 00 00 0A B2 FB FC FD FE F0 53 00 C3 08
			29 01 00 00 00 00 07 B3 5B 00 FB 20 22 0C
			29 01 00 00 00 00 0A B4 FF 00 01 02 C0 40 03 08 53
			29 01 00 00 00 00 0C B5 00 00 FF 83 22 24 00 00 33 00 44
			29 01 00 00 00 00 08 B6 80 00 00 00 96 81 00
			29 01 00 00 00 00 09 B7 00 00 16 16 16 16 00 00
			29 01 00 00 00 00 04 B8 D2 00 00
			29 01 00 00 00 00 02 B9 90
			29 01 00 00 00 00 11 BA 6F DB 96 16 26 36 FF FF FF FF F0 F1 F0 F8 AC EF
			29 01 00 00 00 00 11 BB F8 AC EF F0 2F 3F FF FF FF FF F0 F1 1F FF DB 9F
			29 01 00 00 00 00 05 BC 85 FF FF A1
			29 01 00 00 00 00 05 BD 86 FF FF 61
			29 01 00 00 00 00 05 C0 00 01 FA 00
			29 01 00 00 00 00 06 F0 55 AA 52 08 00
			29 01 00 00 00 00 04 B0 00 10 10
			29 01 00 00 00 00 02 B1 FC
			29 01 00 00 00 00 02 BA 01
			29 01 00 00 00 00 04 BC 00 00 00
			29 01 00 00 00 00 02 35 00
			29 01 00 00 96 00 02 11 00
			29 01 00 00 78 00 02 29 00];
		qcom,mdss-dsi-off-command = [05 01 00 00 32 00 02 28 00
					05 01 00 00 78 00 02 10 00];
		qcom,mdss-dsi-on-command-state = "dsi_lp_mode";
		qcom,mdss-dsi-off-command-state = "dsi_hs_mode";
		qcom,mdss-dsi-h-sync-pulse = <1>;
		qcom,mdss-dsi-traffic-mode = "burst_mode";
		qcom,mdss-dsi-lane-map = "lane_map_0123";
		qcom,mdss-dsi-bllp-eof-power-mode;
		qcom,mdss-dsi-bllp-power-mode;
		qcom,mdss-dsi-lane-0-state;
		qcom,mdss-dsi-lane-1-state;
		/* Modified by JZZ(zhizhang) adjust MIPI frequent to 418MHz for mitigate noise to RF 20141027 */
		qcom,mdss-dsi-panel-timings = [83 1A 10 00 3E 40 16 1E 15 03 04 00];
		qcom,mdss-dsi-t-clk-post = <0x1e>;
		qcom,mdss-dsi-t-clk-pre = <0x38>;
		qcom,mdss-dsi-bl-min-level = <1>;
		qcom,mdss-dsi-bl-max-level = <4095>;
		qcom,mdss-dsi-bl-pmic-control-type = "bl_ctrl_pwm";
		qcom,mdss-dsi-bl-pmic-pwm-frequency = <100>;
		qcom,mdss-dsi-bl-pmic-bank-select = <0>;
		qcom,mdss-dsi-pwm-gpio = <&pm8909_mpps 2 0>;
		qcom,mdss-dsi-dma-trigger = "trigger_sw";
		qcom,mdss-dsi-mdp-trigger = "none";
		qcom,mdss-dsi-reset-sequence = <1 20>, <0 20>, <1 20>;
	};
};
