/**********uniscope-driver-modify-file-on-qualcomm-platform*****************/
/* Copyright (c) 2013, The Linux Foundation. All rights reserved.
 *
 * This program is free software; you can redistribute it and/or modify
 * it under the terms of the GNU General Public License version 2 and
 * only version 2 as published by the Free Software Foundation.
 *
 * This program is distributed in the hope that it will be useful,
 * but WITHOUT ANY WARRANTY; without even the implied warranty of
 * MERCHANTABILITY or FITNESS FOR A PARTICULAR PURPOSE.  See the
 * GNU General Public License for more details.
 */

/*---------------------------------------------------------------------------
 * This file is autogenerated file using gcdb parser. Please do not edit it.
 * Update input XML file to add a new entry or update variable in this file
 * VERSION = "1.0"
 *---------------------------------------------------------------------------*/

&mdss_mdp {
	dsi_otm1287a_720p_video: qcom,mdss_dsi_otm1287a_720p_video {
		qcom,mdss-dsi-panel-name = "otm1287a 720p video mode dsi panel";
		qcom,mdss-dsi-panel-controller = <&mdss_dsi0>;
		qcom,mdss-dsi-panel-type = "dsi_video_mode";
		qcom,mdss-dsi-panel-destination = "display_1";
		qcom,mdss-dsi-panel-framerate = <60>;
		qcom,mdss-dsi-virtual-channel-id = <0>;
		qcom,mdss-dsi-stream = <0>;
		qcom,mdss-dsi-panel-width = <720>;
		qcom,mdss-dsi-panel-height = <1280>;
		qcom,mdss-dsi-h-front-porch = <52>;
		qcom,mdss-dsi-h-back-porch = <100>;
		qcom,mdss-dsi-h-pulse-width = <24>;
		qcom,mdss-dsi-h-sync-skew = <0>;
		qcom,mdss-dsi-v-back-porch = <20>;
		qcom,mdss-dsi-v-front-porch = <8>;
		qcom,mdss-dsi-v-pulse-width = <4>;
		qcom,mdss-dsi-h-left-border = <0>;
		qcom,mdss-dsi-h-right-border = <0>;
		qcom,mdss-dsi-v-top-border = <0>;
		qcom,mdss-dsi-v-bottom-border = <0>;
		qcom,mdss-dsi-bpp = <24>;
		qcom,mdss-dsi-color-order = "rgb_swap_rgb";
		qcom,mdss-dsi-underflow-color = <0xff>;
		qcom,mdss-dsi-border-color = <0>;
		qcom,mdss-dsi-on-command = [29 01 00 00 00 00 02 00 00
			29 01 00 00 00 00 04 FF 12 87 01
			29 01 00 00 00 00 02 00 80
			29 01 00 00 00 00 03 FF 12 87
			29 01 00 00 00 00 02 00 92
			29 01 00 00 00 00 03 FF 30 02
			29 01 00 00 00 00 02 00 80
			29 01 00 00 00 00 0A C0 00 64 00 10 10 00 64 10 10 
			29 01 00 00 00 00 02 00 90
			29 01 00 00 00 00 07 C0 00 5c 00 01 00 04
			29 01 00 00 00 00 02 00 B3
			29 01 00 00 00 00 03 C0 00 55
			29 01 00 00 00 00 02 00 81
			29 01 00 00 00 00 02 C1 55
			29 01 00 00 00 00 02 00 A0
			29 01 00 00 00 00 0F C4 05 10 04 02 05 15 11 05 10 07 02 05 15 11
			29 01 00 00 00 00 02 00 B0
			29 01 00 00 00 00 03 C4 00 00
			29 01 00 00 00 00 02 00 91
			29 01 00 00 00 00 03 C5 A6 D2
			29 01 00 00 00 00 02 00 00
			29 01 00 00 00 00 03 D8 C7 C7
			29 01 00 00 00 00 02 00 00
			29 01 00 00 00 00 02 D9 69
			29 01 00 00 00 00 02 00 B3
			29 01 00 00 00 00 02 C5 84
			29 01 00 00 00 00 02 00 BB
			29 01 00 00 00 00 02 C5 8A
			29 01 00 00 00 00 02 00 82
			29 01 00 00 00 00 02 C4 0A
			29 01 00 00 00 00 02 00 C6
			29 01 00 00 00 00 02 B0 03
			29 01 00 00 00 00 02 00 00
			29 01 00 00 00 00 02 D0 40
			29 01 00 00 00 00 02 00 00
			29 01 00 00 00 00 03 D1 00 00
			29 01 00 00 00 00 02 00 B2
			29 01 00 00 00 00 03 F5 00 00
			29 01 00 00 00 00 02 00 B6
			29 01 00 00 00 00 03 F5 00 00
			29 01 00 00 00 00 02 00 94
			29 01 00 00 00 00 03 F5 00 00
			29 01 00 00 00 00 02 00 D2
			29 01 00 00 00 00 03 F5 06 15
			29 01 00 00 00 00 02 00 B4
			29 01 00 00 00 00 02 C5 CC
			29 01 00 00 00 00 02 00 90
			29 01 00 00 00 00 05 F5 02 11 02 15
			29 01 00 00 00 00 02 00 90
			29 01 00 00 00 00 02 C5 50
			29 01 00 00 00 00 02 00 94
			29 01 00 00 00 00 02 C5 66
			29 01 00 00 00 00 02 00 80
			29 01 00 00 00 00 0C CB 00 00 00 00 00 00 00 00 00 00 00
			29 01 00 00 00 00 02 00 90
			29 01 00 00 00 00 10 CB 00 00 00 00 00 00 00 00 00 00 00 00 00 00 00
			29 01 00 00 00 00 02 00 A0
			29 01 00 00 00 00 10 CB 00 00 00 00 00 00 00 00 00 00 00 00 00 00 00
			29 01 00 00 00 00 02 00 B0
			29 01 00 00 00 00 10 CB 00 00 00 00 00 00 00 00 00 00 00 00 00 00 00
			29 01 00 00 00 00 02 00 C0
			29 01 00 00 00 00 10 CB 05 05 05 05 05 05 05 05 05 00 05 00 00 00 00
			29 01 00 00 00 00 02 00 D0
			29 01 00 00 00 00 10 CB 00 00 00 00 05 00 00 05 05 05 05 05 05 05 05
			29 01 00 00 00 00 02 00 E0
			29 01 00 00 00 00 0F CB 05 00 05 00 00 00 00 00 00 00 00 05 00 00
			29 01 00 00 00 00 02 00 F0
			29 01 00 00 00 00 0C CB ff ff ff ff ff ff ff ff ff ff ff
			29 01 00 00 00 00 02 00 80
			29 01 00 00 00 00 10 cc 29 2a 0a 0c 0e 10 12 14 06 00 08 00 00 00 00
			29 01 00 00 00 00 02 00 90
			29 01 00 00 00 00 10 cc 00 00 00 00 02 00 00 29 2a 09 0b 0d 0f 11 13
			29 01 00 00 00 00 02 00 a0
			29 01 00 00 00 00 0F cc 05 00 07 00 00 00 00 00 00 00 00 01 00 00
			29 01 00 00 00 00 02 00 b0
			29 01 00 00 00 00 10 cc 29 2a 13 11 0f 0d 0b 09 01 00 07 00 00 00 00
			29 01 00 00 00 00 02 00 c0
			29 01 00 00 00 00 10 cc 00 00 00 00 05 00 00 29 2a 14 12 10 0e 0c 0a
			29 01 00 00 00 00 02 00 d0
			29 01 00 00 00 00 0F cc 02 00 08 00 00 00 00 00 00 00 00 06 00 00
			29 01 00 00 00 00 02 00 80
			29 01 00 00 00 00 0D ce 89 05 10 88 05 10 00 00 00 00 00 00
			29 01 00 00 00 00 02 00 90
			29 01 00 00 00 00 0F ce 54 fc 10 54 fd 10 55 00 10 55 01 10 00 00
			29 01 00 00 00 00 02 00 A0
			29 01 00 00 00 00 0F ce 58 07 04 fc 00 10 00 58 06 04 fd 00 10 00
			29 01 00 00 00 00 02 00 b0
			29 01 00 00 00 00 0F ce 58 05 04 fe 00 10 00 58 04 04 ff 00 10 00
			29 01 00 00 00 00 02 00 c0
			29 01 00 00 00 00 0F ce 58 03 05 00 00 10 00 58 02 05 01 00 10 00
			29 01 00 00 00 00 02 00 d0
			29 01 00 00 00 00 0F ce 58 01 05 02 00 10 00 58 00 05 03 00 10 00
			29 01 00 00 00 00 02 00 80
			29 01 00 00 00 00 0F cf 50 00 05 04 00 10 00 50 01 05 05 00 10 00
			29 01 00 00 00 00 02 00 90
			29 01 00 00 00 00 0F cf 50 02 05 06 00 10 00 50 03 05 07 00 10 00
			29 01 00 00 00 00 02 00 a0
			29 01 00 00 00 00 0F cf 00 00 00 00 00 00 00 00 00 00 00 00 00 00
			29 01 00 00 00 00 02 00 b0
			29 01 00 00 00 00 0F cf 00 00 00 00 00 00 00 00 00 00 00 00 00 00
			29 01 00 00 00 00 02 00 c0
			29 01 00 00 00 00 0c cf 39 39 20 20 00 00 01 01 20 00 00
			29 01 00 00 00 00 02 00 b5
			29 01 00 00 00 00 07 c5 0b 95 ff 0b 95 ff
			29 01 00 00 00 00 02 00 00
			29 01 00 00 00 00 15 E1 00 2d 3d 4b 5a 69 67 8b 7a 8a 79 69 7f 58 56 47 35 1f 0a 00
			29 01 00 00 00 00 02 00 00
			29 01 00 00 00 00 15 E2 00 2d 3d 4b 5a 69 67 8b 7a 8a 79 69 7f 58 56 47 35 1f 0a 00
			29 01 00 00 00 00 02 00 00
			29 01 00 00 00 00 04 ff ff ff ff
			05 01 00 00 78 00 02 11 00
			05 01 00 00 32 00 02 29 00];
		qcom,mdss-dsi-off-command = [05 01 00 00 32 00 02 28 00
					05 01 00 00 78 00 02 10 00];
		qcom,mdss-dsi-on-command-state = "dsi_lp_mode";
		qcom,mdss-dsi-off-command-state = "dsi_lp_mode";
		qcom,mdss-dsi-h-sync-pulse = <1>;
		qcom,mdss-dsi-traffic-mode = "burst_mode";
		qcom,mdss-dsi-lane-map = "lane_map_0123";      
		qcom,mdss-dsi-bllp-eof-power-mode;
		qcom,mdss-dsi-bllp-power-mode;
		qcom,mdss-dsi-lane-0-state;
		qcom,mdss-dsi-lane-1-state;
		qcom,mdss-dsi-lane-2-state;
		qcom,mdss-dsi-lane-3-state;
		qcom,mdss-dsi-panel-timings = [92 1A 12 00 3E 42 16 1E 14 03 04 00];
		qcom,mdss-dsi-t-clk-post = <0x04>;
		qcom,mdss-dsi-t-clk-pre = <0x1C>;
		qcom,mdss-dsi-bl-min-level = <1>;
		qcom,mdss-dsi-bl-max-level = <4095>;
		qcom,mdss-dsi-bl-pmic-control-type = "bl_ctrl_pwm";
		qcom,mdss-dsi-bl-pmic-pwm-frequency = <100>;
		qcom,mdss-dsi-bl-pmic-bank-select = <0>;
		qcom,mdss-dsi-pwm-gpio = <&pm8909_mpps 2 0>;
		qcom,mdss-dsi-dma-trigger = "trigger_sw";
		qcom,mdss-dsi-mdp-trigger = "none";
		//qcom,mdss-dsi-bl-pmic-control-type = "bl_ctrl_wled";
		qcom,mdss-dsi-reset-sequence = <1 10>, <0 10>, <1 120>;   //20   2   120
	};
};
