/**********uniscope-driver-modify-file-on-qualcomm-platform*****************/
/* Copyright (c) 2013, The Linux Foundation. All rights reserved.
 *
 * This program is free software; you can redistribute it and/or modify
 * it under the terms of the GNU General Public License version 2 and
 * only version 2 as published by the Free Software Foundation.
 *
 * This program is distributed in the hope that it will be useful,
 * but WITHOUT ANY WARRANTY; without even the implied warranty of
 * MERCHANTABILITY or FITNESS FOR A PARTICULAR PURPOSE.  See the
 * GNU General Public License for more details.
 */
  

/*---------------------------------------------------------------------------
 * This file is autogenerated file using gcdb parser. Please do not edit it.
 * Update input XML file to add a new entry or update variable in this file
 * VERSION = "1.0"
 *---------------------------------------------------------------------------*/

/*---------------------------------------------------------------------------
 * This file is added by <JZZ(zhizhang)>@uniscope 2014-05-06  
 * adding OTM9605A_QHD_VIDEO_PANEL screen.
 *---------------------------------------------------------------------------*/

&mdss_mdp {
	dsi_otm9605a_qhd_vid: qcom,mdss_dsi_otm9605a_qhd_video {
		qcom,mdss-dsi-panel-name = "otm9605a qhd video mode dsi panel";
		qcom,mdss-dsi-panel-controller = <&mdss_dsi0>;
		qcom,mdss-dsi-panel-type = "dsi_video_mode";
		qcom,mdss-dsi-panel-destination = "display_1";
		qcom,mdss-dsi-panel-framerate = <60>;
		qcom,mdss-dsi-virtual-channel-id = <0>;
		qcom,mdss-dsi-stream = <0>;
		qcom,mdss-dsi-panel-width = <540>;
		qcom,mdss-dsi-panel-height = <960>;
		qcom,mdss-dsi-h-front-porch = <80>;
		qcom,mdss-dsi-h-back-porch = <24>;
		qcom,mdss-dsi-h-pulse-width = <14>;
		qcom,mdss-dsi-h-sync-skew = <0>;
		qcom,mdss-dsi-v-back-porch = <14>;
		qcom,mdss-dsi-v-front-porch = <25>;
		qcom,mdss-dsi-v-pulse-width = <2>;
		qcom,mdss-dsi-h-left-border = <0>;
		qcom,mdss-dsi-h-right-border = <0>;
		qcom,mdss-dsi-v-top-border = <0>;
		qcom,mdss-dsi-v-bottom-border = <0>;
		qcom,mdss-dsi-bpp = <24>;
		qcom,mdss-dsi-color-order = "rgb_swap_rgb";
		qcom,mdss-dsi-underflow-color = <0xff>;
		qcom,mdss-dsi-border-color = <0>;
		qcom,mdss-dsi-on-command = [
			29 01 00 00 00 00 02
				00 00
			29 01 00 00 00 00 04
				ff 96 05 01
			29 01 00 00 00 00 02
				00 80
			29 01 00 00 00 00 03
				ff 96 05
			29 01 00 00 00 00 02
				00 00
			29 01 00 00 00 00 02
				a0 00
			29 01 00 00 00 00 02
				00 c5
			29 01 00 00 00 00 02
				b0 03
			29 01 00 00 00 00 02
				00 83
			29 01 00 00 00 00 02
				b2 80
			29 01 00 00 00 00 02
				00 89
			29 01 00 00 00 00 02
				C0 01
			29 01 00 00 00 00 02
				00 b4
			29 01 00 00 00 00 03
				C0 50 87
			29 01 00 00 00 00 02
				00 80
			29 01 00 00 00 00 03
				C1 36 66
			29 01 00 00 00 00 02
				00 A0
			29 01 00 00 00 00 02
				C1 00
			29 01 00 00 00 00 02
				00 80
			29 01 00 00 00 00 02
				C4 9C
			29 01 00 00 00 00 02
				00 80
			29 01 00 00 00 00 05
				C5 08 00 A0
				11
			29 01 00 00 00 00 02
				00 90
			29 01 00 00 00 00 08
				C5 96 76 01
				76 33 33 34
			29 01 00 00 00 00 02
				00 B0
			29 01 00 00 00 00 03
				C5 04 28
			29 01 00 00 00 00 02
				00 C0
			29 01 00 00 00 00 02
				C5 00
			29 01 00 00 00 00 02
				00 00
			29 01 00 00 00 00 02
				D0 40
			29 01 00 00 00 00 02
				00 00
			29 01 00 00 00 00 03
				D1 00 00
			29 01 00 00 00 00 02
				00 B2
			29 01 00 00 00 00 05
				F5 15 00 15
				00
			29 01 00 00 00 00 02
				00 80
			29 01 00 00 00 00 0B
				CB 00 00 00
				00 00 00 00
				00 00 00
			29 01 00 00 00 00 02
				00 90
			29 01 00 00 00 00 10
				CB 00 00 00
				00 00 00 00
				00 00 00 00
				00 00 00 00
			29 01 00 00 00 00 02
				00 A0
			29 01 00 00 00 00 10
				CB 00 00 00
				00 00 00 00
				00 00 00 00
				00 00 00 00
			29 01 00 00 00 00 02
				00 B0
			29 01 00 00 00 00 0B
				CB 00 00 00
				00 00 00 00
				00 00 00
			29 01 00 00 00 00 02
				00 C0
			29 01 00 00 00 00 10
				CB 04 04 04
				04 00 04 00
				04 00 04 00
				04 04 04 00
			29 01 00 00 00 00 02
				00 D0
			29 01 00 00 00 00 10
				CB 00 00 00
				00 00 04 04
				04 04 00 04
				00 04 00 04
			29 01 00 00 00 00 02
				00 E0
			29 01 00 00 00 00 0B
				CB 00 04 04
				04 00 00 00
				00 00 00
			29 01 00 00 00 00 02
				00 F0
			29 01 00 00 00 00 0B
				CB 00 CC CC
				00 00 00 CC
				CC 0F 00
			29 01 00 00 00 00 02
				00 80
			29 01 00 00 00 00 0B
				CC 26 25 21
				22 00 0C 00
				0A 00 10
			29 01 00 00 00 00 02
				00 90
			29 01 00 00 00 00 10
				CC 00 0E 02
				04 00 00 00
				00 00 00 26
				25 21 22 00
			29 01 00 00 00 00 02
				00 A0
			29 01 00 00 00 00 10
				CC 0B 00 09
				00 0F 00 0D
				01 03 00 00
				00 00 00 00
			29 01 00 00 00 00 02
				00 B0
			29 01 00 00 00 00 0B
				CC 25 26 21
				22 00 0D 00
				0F 00 09
			29 01 00 00 00 00 02
				00 C0
			29 01 00 00 00 00 10
				CC 00 0B 03
				01 00 00 00
				00 00 00 25
				26 21 22 00
			29 01 00 00 00 00 02
				00 D0
			29 01 00 00 00 00 10
				CC 0E 00 10
				00 0A 00 0C
				04 02 00 00
				00 00 00 00
			29 01 00 00 00 00 02
				00 80
			29 01 00 00 00 00 0D
				CE 8B 03 28
				8A 03 28 89
				03 28 88 03
				28
			29 01 00 00 00 00 02
				00 90
			29 01 00 00 00 00 0F
				CE F0 00 00
				F0 00 00 F0
				00 00 F0 00
				00 00 00
			29 01 00 00 00 00 02
				00 A0
			29 01 00 00 00 00 0F
				CE 38 07 03
				C0 00 18 00
				38 06 03 C1
				00 18 00
			29 01 00 00 00 00 02
				00 B0
			29 01 00 00 00 00 0F
				CE 38 05 03
				C2 00 18 00
				38 04 03 C3
				00 18 00
			29 01 00 00 00 00 02
				00 C0
			29 01 00 00 00 00 0F
				CE 38 03 03
				C4 00 18 00
				38 02 03 C5
				00 18 00
			29 01 00 00 00 00 02
				00 D0
			29 01 00 00 00 00 0F
				CE 38 01 03
				C6 00 18 00
				38 00 03 C7
				00 18 00
			29 01 00 00 00 00 02
				00 C0
			29 01 00 00 00 00 02
				CF 02
			29 01 00 00 00 00 02
				00 C7
			29 01 00 00 00 00 02
				CF 80
			29 01 00 00 00 00 02
				00 C9
			29 01 00 00 00 00 02
				CF 08
			29 01 00 00 00 00 02
				00 00
			29 01 00 00 00 00 03
				D8 6F 6F
			29 01 00 00 00 00 02
				00 00
			29 01 00 00 00 00 02
				D9 3B
			29 01 00 00 00 00 02
				00 00
			29 01 00 00 00 00 11
				E1 01 08 0D
				0D 06 0C 0A
				09 05 08 10
				08 0F 10 09
				04
			29 01 00 00 00 00 02
				00 00
			29 01 00 00 00 00 11
				E2 01 08 0D
				0D 06 0C 0A
				09 05 08 10
				08 0F 10 09
				04
			29 01 00 00 00 00 02
				00 B1
			29 01 00 00 00 00 02
				C5 28
			29 01 00 00 00 00 02
				00 80
			29 01 00 00 00 00 02
				C4 9C
			29 01 00 00 00 00 02
				00 C0
			29 01 00 00 00 00 02
				C5 00
			29 01 00 00 00 00 02
				00 B2
			29 01 00 00 00 00 05
				F5 15 00 15
				00
			29 01 00 00 00 00 02
				00 93
			29 01 00 00 00 00 02
				C5 03
			29 01 00 00 00 00 02
				00 80
			29 01 00 00 00 00 03
				C1 36 66
			29 01 00 00 00 00 02
				00 89
			29 01 00 00 00 00 02
				C0 01
			29 01 00 00 00 00 02
				00 A0
			29 01 00 00 00 00 02
				C1 00
			29 01 00 00 00 00 02
				00 C5
			29 01 00 00 00 00 02
				B0 03
			29 01 00 00 00 00 02
				00 00
			29 01 00 00 00 00 04
				FF FF FF FF
			05 01 00 00 78 00 02
				11 00
			05 01 00 00 32 00 02
				29 00
				];
		qcom,mdss-dsi-off-command = [05 01 00 00 32 00 02 28 00
					05 01 00 00 78 00 02 10 00];
		qcom,mdss-dsi-on-command-state = "dsi_lp_mode";
		qcom,mdss-dsi-off-command-state = "dsi_lp_mode";
		qcom,mdss-dsi-h-sync-pulse = <1>;
		qcom,mdss-dsi-traffic-mode = <2>;
		qcom,mdss-dsi-lane-map = <0>;
		qcom,mdss-dsi-bllp-eof-power-mode;
		qcom,mdss-dsi-bllp-power-mode;
		qcom,mdss-dsi-lane-0-state;
		qcom,mdss-dsi-lane-1-state;
		qcom,mdss-dsi-panel-timings = [68 1d 15 00 2e 2d 19 1f 24 03 04 00];
		qcom,mdss-dsi-t-clk-post = <0x1e>;
		qcom,mdss-dsi-t-clk-pre = <0x38>;
		qcom,mdss-dsi-bl-min-level = <1>;
		qcom,mdss-dsi-bl-max-level = <4095>;
		qcom,mdss-dsi-bl-pmic-control-type = "bl_ctrl_pwm";
		qcom,mdss-dsi-bl-pmic-pwm-frequency = <100>;
		qcom,mdss-dsi-bl-pmic-bank-select = <0>;
		qcom,mdss-dsi-pwm-gpio = <&pm8909_mpps 2 0>;
		qcom,mdss-dsi-dma-trigger = "trigger_sw";
		qcom,mdss-dsi-mdp-trigger = "none";
		qcom,mdss-dsi-reset-sequence = <1 20>, <0 20>, <1 20>;
	};
};
