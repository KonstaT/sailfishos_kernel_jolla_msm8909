/**********uniscope-driver-modify-file-on-qualcomm-platform*****************/
/* Copyright (c) 2013, The Linux Foundation. All rights reserved.
 *
 * This program is free software; you can redistribute it and/or modify
 * it under the terms of the GNU General Public License version 2 and
 * only version 2 as published by the Free Software Foundation.
 *
 * This program is distributed in the hope that it will be useful,
 * but WITHOUT ANY WARRANTY; without even the implied warranty of
 * MERCHANTABILITY or FITNESS FOR A PARTICULAR PURPOSE.  See the
 * GNU General Public License for more details.
 */

/*---------------------------------------------------------------------------
 * This file is autogenerated file using gcdb parser. Please do not edit it.
 * Update input XML file to add a new entry or update variable in this file
 * VERSION = "1.0"
 *---------------------------------------------------------------------------*/
&mdss_mdp {
	dsi_rm68172_wvga_video: qcom,mdss_dsi_rm68172_wvga_video {
		qcom,mdss-dsi-panel-name = "rm68172 wvga video mode dsi panel";
		qcom,mdss-dsi-panel-controller = <&mdss_dsi0>;
		qcom,mdss-dsi-panel-type = "dsi_video_mode";
		qcom,mdss-dsi-panel-destination = "display_1";
		qcom,mdss-dsi-panel-framerate = <60>;
		qcom,mdss-dsi-virtual-channel-id = <0>;
		qcom,mdss-dsi-stream = <0>;
		qcom,mdss-dsi-panel-width = <480>;
		qcom,mdss-dsi-panel-height = <800>;
		/* Modified by JZZ(zhizhang) adjust MIPI frequent to 
		  418MHz for mitigate noise to RF 20141027 begin */
		qcom,mdss-dsi-h-front-porch = <80>;
		qcom,mdss-dsi-h-back-porch = <80>;
		qcom,mdss-dsi-h-pulse-width = <30>;
		qcom,mdss-dsi-h-sync-skew = <0>;
		qcom,mdss-dsi-v-back-porch = <25>;
		qcom,mdss-dsi-v-front-porch = <25>;
		qcom,mdss-dsi-v-pulse-width = <18>;
		/* Modified by JZZ(zhizhang) adjust MIPI frequent to 
		  418MHz for mitigate noise to RF 20141027 begin */
		qcom,mdss-dsi-h-left-border = <0>;
		qcom,mdss-dsi-h-right-border = <0>;
		qcom,mdss-dsi-v-top-border = <0>;
		qcom,mdss-dsi-v-bottom-border = <0>;
		qcom,mdss-dsi-bpp = <24>;
		qcom,mdss-dsi-color-order = "rgb_swap_rgb";
		qcom,mdss-dsi-underflow-color = <0xff>;
		qcom,mdss-dsi-border-color = <0>;
		qcom,mdss-dsi-on-command = [29 01 00 00 00 00 06 F0 55 AA 52 08 02
			29 01 00 00 00 00 02 F6 60
			29 01 00 00 00 00 06 F0 55 AA 52 08 01
			29 01 00 00 00 00 02 B0 0D
			29 01 00 00 00 00 02 B1 10
			29 01 00 00 00 00 02 B2 00
			29 01 00 00 00 00 02 B5 08
			29 01 00 00 00 00 02 B6 34
			29 01 00 00 00 00 02 B7 44
			29 01 00 00 00 00 02 B8 24
			29 01 00 00 00 00 02 B9 34
			29 01 00 00 00 00 02 BA 14
			29 01 00 00 00 00 04 BC 00 5e 00
			29 01 00 00 00 00 04 BD 00 5e 00
			29 01 00 00 00 00 03 BE 00 63
			29 01 00 00 00 00 35 D1 
				00 00 00 01 00 10 
				00 2F 00 54 00 A2
			    00 E0 01 34 01 6A 
			    01 AE 01 DB 02 18 
			    02 44 02 45 02 6D 
			    02 93 02 A8 02 C1 
			    02 D1 02 E5 02 F3 
			    03 05 03 12 03 25 
			    03 51 03 F9
			29 01 00 00 00 00 35 D2 00 
				00 00 01 00 10 00 
				2F 00 54 00 A2 00 
				E0 01 34 01 6A 01 
				AE 01 DB 02 18 02
				44 02 45 02 6D 02
				93 02 A8 02 C1 02 
				D1 02 E5 02 F3 03 
				05 03 12 03 25 03 
				51 03 F9
			29 01 00 00 00 00 35 D3 00 
			   00 00 01 00 10 00 
			   2F 00 54 00 A2 00 
			   E0 01 34 01 6A 01 
			   AE 01 DB 02 18 02
			   44 02 45 02 6D 02
			   93 02 A8 02 C1 02
			   D1 02 E5 02 F3 03
			   05 03 12 03 25 03 
			   51 03 F9
			29 01 00 00 00 00 35 D4 00
			   00 00 01 00 10 00
			   2F 00 54 00 A2 00
			   E0 01 34 01 6A 01
			   AE 01 DB 02 18 02 
			   44 02 45 02 6D 02 
			   93 02 A8 02 C1 02
			   D1 02 E5 02 F3 03
			   05 03 12 03 25 03
			   51 03 F9
			29 01 00 00 00 00 35 D5 00
			   00 00 01 00 10 00 
			   2F 00 54 00 A2 00 
			   E0 01 34 01 6A 01 
			   AE 01 DB 02 18 02
			   44 02 45 02 6D 02
			   93 02 A8 02 C1 02
			   D1 02 E5 02 F3 03
			   05 03 12 03 25 03
			   51 03 F9
			29 01 00 00 00 00 35 D6 00
			   00 00 01 00 10 00 
			   2F 00 54 00 A2 00
			   E0 01 34 01 6A 01 
			   AE 01 DB 02 18 02
			   44 02 45 02 6D 02
			   93 02 A8 02 C1 02
			   D1 02 E5 02 F3 03 
			   05 03 12 03 25 03
			   51 03 F9
			29 01 00 00 00 00 06 F0 
			   55 AA 52 08 03
			29 01 00 00 00 00 08 B0 03 15 FA 00 00 00 00
			29 01 00 00 00 00 0A B2 FB FC FD FE F0 20 00 83 04
			29 01 00 00 00 00 07 B3 5B 00 FB 21 23 0C
			29 01 00 00 00 00 0C B4 00 00 00 00 00 00 00 00 00 00 00
			29 01 00 00 00 00 0C B5 00 00 00 00 00 00 00 00 00 00 44
			29 01 00 00 00 00 08 B6 00 00 00 00 00 00 00
			29 01 00 00 00 00 09 B7 00 00 20 20 20 20 00 00
			29 01 00 00 00 00 04 B8 00 00 00
			29 01 00 00 00 00 02 B9 82
			29 01 00 00 00 00 11 BA 45 8A 04 5F FF FF FF FF FF FF FF FF F5 41 B9 54
			29 01 00 00 00 00 11 BB 54 B9 15 4F FF FF FF FF FF FF FF FF F4 50 8A 45
			29 01 00 00 00 00 05 BC 47 FF FF E3
			29 01 00 00 00 00 05 BD C7 FF FF E3
			29 01 00 00 00 00 06 F0 55 AA 52 08 00
			29 01 00 00 00 00 02 BC 00
			29 01 00 00 00 00 02 35 00			
			29 01 00 00 64 00 02 11 00
			29 01 00 00 78 00 02 29 00];
		qcom,mdss-dsi-off-command = [05 01 00 00 32 00 02 28 00
					05 01 00 00 78 00 02 10 00];
		qcom,mdss-dsi-on-command-state = "dsi_lp_mode";
		qcom,mdss-dsi-off-command-state = "dsi_hs_mode";
		qcom,mdss-dsi-panel-status-command = [06 01 00 01 05 00 02 0A 08];
		qcom,mdss-dsi-panel-status-command-state = "dsi_hs_mode";
		qcom,mdss-dsi-panel-status-check-mode = "reg_read";
		qcom,mdss-dsi-panel-status-value = <0x9c>;
		qcom,mdss-dsi-h-sync-pulse = <1>;
		qcom,mdss-dsi-traffic-mode = "burst_mode";
		qcom,mdss-dsi-lane-map = "lane_map_0123";
		qcom,mdss-dsi-bllp-eof-power-mode;
		qcom,mdss-dsi-bllp-power-mode;
		qcom,mdss-dsi-lane-0-state;
		qcom,mdss-dsi-lane-1-state;
		/* Modified by JZZ(zhizhang) adjust MIPI frequent to 418MHz for mitigate noise to RF 20141027 */
		qcom,mdss-dsi-panel-timings = [83 1A 10 00 3E 40 16 1E 15 03 04 00];
		qcom,mdss-dsi-t-clk-post = <0x1e>;
		qcom,mdss-dsi-t-clk-pre = <0x38>;
		qcom,mdss-dsi-bl-min-level = <1>;
		qcom,mdss-dsi-bl-max-level = <4095>;
		qcom,mdss-dsi-bl-pmic-control-type = "bl_ctrl_pwm";
		qcom,mdss-dsi-bl-pmic-pwm-frequency = <100>;
		qcom,mdss-dsi-bl-pmic-bank-select = <0>;
		qcom,mdss-dsi-pwm-gpio = <&pm8909_mpps 2 0>;
		qcom,mdss-dsi-dma-trigger = "trigger_sw";
		qcom,mdss-dsi-mdp-trigger = "none";
		qcom,mdss-dsi-reset-sequence = <1 20>, <0 20>, <1 20>;
	};
};
