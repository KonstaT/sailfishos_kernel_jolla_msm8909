/**********uniscope-driver-modify-file-on-qualcomm-platform*****************/
/* Copyright (c) 2013, The Linux Foundation. All rights reserved.
 *
 * This program is free software; you can redistribute it and/or modify
 * it under the terms of the GNU General Public License version 2 and
 * only version 2 as published by the Free Software Foundation.
 *
 * This program is distributed in the hope that it will be useful,
 * but WITHOUT ANY WARRANTY; without even the implied warranty of
 * MERCHANTABILITY or FITNESS FOR A PARTICULAR PURPOSE.  See the
 * GNU General Public License for more details.
 */

/*---------------------------------------------------------------------------
 * This file is autogenerated file using gcdb parser. Please do not edit it.
 * Update input XML file to add a new entry or update variable in this file
 * VERSION = "1.0"
 *---------------------------------------------------------------------------*/
&mdss_mdp {
	dsi_rm68191_zrs_qhd_video: qcom,mdss_dsi_rm68191_zrs_qhd_video {
		qcom,mdss-dsi-panel-name = "rm68191 zrs qhd video mode dsi panel";
		qcom,mdss-dsi-panel-controller = <&mdss_dsi0>;
		qcom,mdss-dsi-panel-type = "dsi_video_mode";
		qcom,mdss-dsi-panel-destination = "display_1";
		qcom,mdss-dsi-panel-framerate = <60>;
		qcom,mdss-dsi-virtual-channel-id = <0>;
		qcom,mdss-dsi-stream = <0>;
		qcom,mdss-dsi-panel-width = <540>;
		qcom,mdss-dsi-panel-height = <960>;
		qcom,mdss-dsi-h-front-porch = <60>;
		qcom,mdss-dsi-h-back-porch = <60>;
		qcom,mdss-dsi-h-pulse-width = <30>;
		qcom,mdss-dsi-h-sync-skew = <0>;
		qcom,mdss-dsi-v-back-porch = <30>;
		qcom,mdss-dsi-v-front-porch = <20>;
		qcom,mdss-dsi-v-pulse-width = <2>;
		qcom,mdss-dsi-h-left-border = <0>;
		qcom,mdss-dsi-h-right-border = <0>;
		qcom,mdss-dsi-v-top-border = <0>;
		qcom,mdss-dsi-v-bottom-border = <0>;
		qcom,mdss-dsi-bpp = <24>;
		qcom,mdss-dsi-color-order = "rgb_swap_rgb";
		qcom,mdss-dsi-underflow-color = <0xff>;
		qcom,mdss-dsi-border-color = <0>;
		qcom,mdss-dsi-on-command = [29 01 00 00 00 00 06 F0 55 AA 52 08 03
		29 01 00 00 00 00 0A 90 05 16 09 03 CD 00 8C 00 00
		29 01 00 00 00 00 0A 91 05 16 0B 03 CF 00 8C 00 00
		29 01 00 00 00 00 0C 92 40 0B 0C 0D 0E 00 54 00 00 05 08
		29 01 00 00 00 00 09 94 00 08 0B 03 D0 03 D2 0C
		29 01 00 00 00 00 11 95 40 0F 00 10 00 11 00 12 00 54 00 00 00 05 00 08
		29 01 00 00 00 00 03 99 00 00																												
		29 01 00 00 00 00 0C 9A 80 0E 03 D4 03 D6 00 00 00 00 50
		29 01 00 00 00 00 07 9B 00 00 00 00 00 00
		29 01 00 00 00 00 03 9C 00 00
		29 01 00 00 00 00 09 9D 01 01 01 01 01 01 00 00
		29 01 00 00 00 00 03 9E 00 00
		29 01 00 00 00 00 0B A0 80 04 1F 1F 1F 1F 0A 1F 0E 1F
		29 01 00 00 00 00 0B A1 1F 1F 1F 1F 0C 1F 08 1F 1F 1F
		29 01 00 00 00 00 0B A2 1F 1F 1F 1F 1F 1F 06 1F 02 1F
		29 01 00 00 00 00 0B A3 1F 1F 1F 1F 1F 1F 1F 1F 1F 1F
		29 01 00 00 00 00 0B A4 1F 1F 1F 1F 1F 03 1F 07 1F 09
		29 01 00 00 00 00 0B A5 1F 0D 1F 1F 1F 1F 1F 0F 1F 0B
		29 01 00 00 00 00 0B A6 1F 1F 1F 1F 1F 05 1F 01 1F 1F
		29 01 00 00 00 00 0B A7 07 03 1F 1F 1F 1F 09 1F 0D 1F
		29 01 00 00 00 00 0B A8 1F 1F 1F 1F 0F 1F 0B 1F 1F 1F
		29 01 00 00 00 00 0B A9 1F 1F 1F 1F 1F 1F 01 1F 05 1F		
		29 01 00 00 00 00 0B AA 1F 1F 1F 1F 1F 1F 1F 1F 1F 1F
		29 01 00 00 00 00 0B AB 1F 1F 1F 1F 1F 04 1F 00 1F 0A
		29 01 00 00 00 00 0B AC 1F 0E 1F 1F 1F 1F 1F 0C 1F 08
		29 01 00 00 00 00 0B AD 1F 1F 1F 1F 1F 02 1F 06 1F 1F
		29 01 00 00 00 00 06 F0 55 AA 52 08 00	
		29 01 00 00 00 00 04 BC 00 00 00
		29 01 00 00 00 00 05 B8 01 AF 8F 8F
		29 01 00 00 00 00 06 F0 55 AA 52 08 01
		29 01 00 00 00 00 11 D1 00 00 00 1B 00 43 00 63 00 7F 00 AB 00 CE 01 05
		29 01 00 00 00 00 11 D2 01 2F 01 6D 01 9C 01 E1 02 19 02 1B 02 4F 02 8C
		29 01 00 00 00 00 11 D3 02 B2 02 E6 03 0A 03 38 03 55 03 79 03 91 03 AA
		29 01 00 00 00 00 05 D4 03 C6 03 FF
		29 01 00 00 00 00 11 D5 00 00 00 1B 00 43 00 63 00 7F 00 AB 00 CE 01 05
		29 01 00 00 00 00 11 D6 01 2F 01 6D 01 9C 01 E1 02 19 02 1B 02 4F 02 8C
		29 01 00 00 00 00 11 D7 02 B2 02 E6 03 0A 03 38 03 55 03 79 03 91 03 AA
		29 01 00 00 00 00 05 D8 03 C6 03 FF
		29 01 00 00 00 00 11 D9 00 00 00 1B 00 43 00 63 00 7F 00 AB 00 CE 01 05
		29 01 00 00 00 00 11 DD 01 2F 01 6D 01 9C 01 E1 02 19 02 1B 02 4F 02 8C
		29 01 00 00 00 00 11 DE 02 B2 02 E6 03 0A 03 38 03 55 03 79 03 91 03 AA
		29 01 00 00 00 00 05 DF 03 C6 03 FF
		29 01 00 00 00 00 11 E0 00 00 00 1B 00 43 00 63 00 7F 00 AB 00 CE 01 05
		29 01 00 00 00 00 11 E1 01 2F 01 6D 01 9C 01 E1 02 19 02 1B 02 4F 02 8C
		29 01 00 00 00 00 11 E2 02 B2 02 E6 03 0A 03 38 03 55 03 79 03 91 03 AA
		29 01 00 00 00 00 05 E3 03 C6 03 FF		
		29 01 00 00 00 00 11 E4 00 00 00 1B 00 43 00 63 00 7F 00 AB 00 CE 01 05
		29 01 00 00 00 00 11 E5 01 2F 01 6D 01 9C 01 E1 02 19 02 1B 02 4F 02 8C
		29 01 00 00 00 00 11 E6 02 B2 02 E6 03 0A 03 38 03 55 03 79 03 91 03 AA
		29 01 00 00 00 00 05 E7 03 C6 03 FF
		29 01 00 00 00 00 11 E8 00 00 00 1B 00 43 00 63 00 7F 00 AB 00 CE 01 05
		29 01 00 00 00 00 11 E9 01 2F 01 6D 01 9C 01 E1 02 19 02 1B 02 4F 02 8C
		29 01 00 00 00 00 11 EA 02 B2 02 E6 03 0A 03 38 03 55 03 79 03 91 03 AA
		29 01 00 00 00 00 05 EB 03 C6 03 FF
		29 01 00 00 00 00 04 B0 07 07 07
		29 01 00 00 00 00 04 B1 07 07 07
		29 01 00 00 00 00 04 B3 10 10 10
		29 01 00 00 00 00 04 B4 08 08 08
		29 01 00 00 00 00 04 B6 44 44 44
		29 01 00 00 00 00 04 B7 34 34 34
		29 01 00 00 00 00 04 B9 34 34 34
		29 01 00 00 00 00 04 BA 14 14 14
		29 01 00 00 00 00 04 BC 00 A0 00
		29 01 00 00 00 00 04 BD 00 A0 00
		29 01 00 00 00 00 02 BE 37
		29 01 00 00 00 00 02 35 00
		29 01 00 00 00 00 02 11 00
		29 01 00 00 00 00 02 29 00];
		qcom,mdss-dsi-off-command = [05 01 00 00 32 00 02 28 00
					05 01 00 00 78 00 02 10 00];
		qcom,mdss-dsi-on-command-state = "dsi_lp_mode";
		qcom,mdss-dsi-off-command-state = "dsi_lp_mode";
		qcom,mdss-dsi-h-sync-pulse = <1>;
		qcom,mdss-dsi-traffic-mode = "burst_mode";
		qcom,mdss-dsi-lane-map = "lane_map_0123";
		qcom,mdss-dsi-bllp-eof-power-mode;
		qcom,mdss-dsi-bllp-power-mode;
		qcom,mdss-dsi-lane-0-state;
		qcom,mdss-dsi-lane-1-state;
		qcom,mdss-dsi-panel-timings = [2c 20 14 00 46 48 1A 22 18 03 04 00];
		qcom,mdss-dsi-t-clk-post = <0x1e>;
		qcom,mdss-dsi-t-clk-pre = <0x38>;
		qcom,mdss-dsi-bl-min-level = <1>;
		qcom,mdss-dsi-bl-max-level = <4095>;
		qcom,mdss-dsi-bl-pmic-control-type = "bl_ctrl_pwm";
		qcom,mdss-dsi-bl-pmic-pwm-frequency = <100>;
		qcom,mdss-dsi-bl-pmic-bank-select = <0>;
		qcom,mdss-dsi-pwm-gpio = <&pm8909_mpps 2 0>;
		qcom,mdss-dsi-dma-trigger = "trigger_sw";
		qcom,mdss-dsi-mdp-trigger = "none";
		qcom,mdss-dsi-reset-sequence = <1 20>, <0 20>, <1 20>;
	};
};
