/**********uniscope-driver-modify-file-on-qualcomm-platform*****************/
/* Copyright (c) 2014, The Linux Foundation. All rights reserved.
 *
 * This program is free software; you can redistribute it and/or modify
 * it under the terms of the GNU General Public License version 2 and
 * only version 2 as published by the Free Software Foundation.
 *
 * This program is distributed in the hope that it will be useful,
 * but WITHOUT ANY WARRANTY; without even the implied warranty of
 * MERCHANTABILITY or FITNESS FOR A PARTICULAR PURPOSE.  See the
 * GNU General Public License for more details.
 */

/*---------------------------------------------------------------------------
 * This file is autogenerated file using gcdb parser. Please do not edit it.
 * Update input XML file to add a new entry or update variable in this file
 * VERSION = "1.0"
 *---------------------------------------------------------------------------*/
&mdss_mdp {
	dsi_otm8019a_wvga_video: qcom,mdss_dsi_otm8019a_wvga_video {
		qcom,mdss-dsi-panel-name = "otm8019a fwvga video mode dsi panel";
		qcom,mdss-dsi-panel-controller = <&mdss_dsi0>;
		qcom,mdss-dsi-panel-type = "dsi_video_mode";
		qcom,mdss-dsi-panel-destination = "display_1";
		qcom,mdss-dsi-panel-framerate = <60>;
		qcom,mdss-dsi-virtual-channel-id = <0>;
		qcom,mdss-dsi-stream = <0>;
		qcom,mdss-dsi-panel-width = <480>;
		qcom,mdss-dsi-panel-height = <800>;
		qcom,mdss-dsi-h-front-porch = <146>;
		qcom,mdss-dsi-h-back-porch = <146>;
		qcom,mdss-dsi-h-pulse-width = <26>;
		qcom,mdss-dsi-h-sync-skew = <0>;
		qcom,mdss-dsi-v-back-porch = <14>;
		qcom,mdss-dsi-v-front-porch = <15>;
		qcom,mdss-dsi-v-pulse-width = <1>;
		qcom,mdss-dsi-h-left-border = <0>;
		qcom,mdss-dsi-h-right-border = <0>;
		qcom,mdss-dsi-v-top-border = <0>;
		qcom,mdss-dsi-v-bottom-border = <0>;
		qcom,mdss-dsi-bpp = <24>;
		qcom,mdss-dsi-color-order = "rgb_swap_rgb";
		qcom,mdss-dsi-underflow-color = <0xff>;
		qcom,mdss-dsi-border-color = <0>;
		qcom,mdss-dsi-on-command = [
				29 01 00 00 00 00 02 
				00 00
				29 01 00 00 00 00 04 
				FF 80 19 01

				29 01 00 00 00 00 02 
				00 80
				29 01 00 00 00 00 03 
				FF 80 19

				29 01 00 00 00 00 02 
				00 8A
				29 01 00 00 00 00 02 
				C4 40

				29 01 00 00 00 00 02 
				00 A6
				29 01 00 00 00 00 03 
				B3 20 01

				29 01 00 00 00 00 02 
				00 90
				29 01 00 00 00 00 07 
				C0 00 15 00 
				00 00 03   

				29 01 00 00 00 00 02 
				00 B4
				29 01 00 00 00 00 02 
				C0 70         

				29 01 00 00 00 00 02 
				00 81
				29 01 00 00 00 00 02 
				C1 33         

				29 01 00 00 00 00 02 
				00 81
				29 01 00 00 00 00 02 
				C4 81

				29 01 00 00 00 00 02 
				00 87
				29 01 00 00 00 00 02 
				C4 00

				29 01 00 00 00 00 02 
				00 89
				29 01 00 00 00 00 02 
				C4 00

				29 01 00 00 00 00 02 
				00 82
				29 01 00 00 00 00 02 
				C5 B0          

				29 01 00 00 00 00 02 
				00 90
				29 01 00 00 00 00 08 
				C5 4E 34 06 
				91 33 34 23  

				29 01 00 00 00 00 02 
				00 B1
				29 01 00 00 00 00 02 
				C5 A8

				29 01 00 00 00 00 02 
				00 00
				29 01 00 00 00 00 03 
				D8 6F 6F

				29 01 00 00 00 00 02 
				00 00
				29 01 00 00 00 00 02 
				D9 40

				29 01 00 00 00 00 02 
				00 80
				29 01 00 00 00 00 0d 
				CE 86 01 00 
				85 01 00 00 
				00 00 00 00 
				00

				29 01 00 00 00 00 02 
				00 A0
				29 01 00 00 00 00 0f 
				CE 18 05 83 
				39 00 00 00 
				18 04 83 3A 
				00 00 00

				29 01 00 00 00 00 02 
				00 B0
				29 01 00 00 00 00 0f 
				CE 18 03 83 
				3B 86 00 00 
				18 02 83 3C 
				88 00 00

				29 01 00 00 00 00 02 
				00 C0
				29 01 00 00 00 00 0b 
				CF 01 01 20 
				20 00 00 01 
				02 00 00

				29 01 00 00 00 00 02 
				00 D0
				29 01 00 00 00 00 02 
				CF 00

				29 01 00 00 00 00 02 
				00 C0
				29 01 00 00 00 00 10 
				CB 00 01 01 
				01 01 01 00 
				00 00 00 00 
				00 00 00 00

				29 01 00 00 00 00 02 
				00 D0
				29 01 00 00 00 00 02 
				CB 00

				29 01 00 00 00 00 02 
				00 D5
				29 01 00 00 00 00 0b 
				CB 00 00 00 
				00 00 00 00 
				00 00 00

				29 01 00 00 00 00 02 
				00 E0
				29 01 00 00 00 00 07 
				CB 01 01 01 
				01 01 00

				29 01 00 00 00 00 02 
				00 80
				29 01 00 00 00 00 0b 
				CC 00 26 09 
				0B 01 25 00 
				00 00 00

				29 01 00 00 00 00 02 
				00 90
				29 01 00 00 00 00 07 
				CC 00 00 00 
				00 00 00

				29 01 00 00 00 00 02 
				00 9A
				29 01 00 00 00 00 06 
				CC 00 00 00 
				00 00

				29 01 00 00 00 00 02 
				00 A0
				29 01 00 00 00 00 0c 
				CC 00 00 00 
				00 00 25 02 
				0c 0a 26 00

				29 01 00 00 00 00 02 
				00 B0
				29 01 00 00 00 00 0b 
				CC 00 25 0C 
				0A 02 26 00 
				00 00 00

				29 01 00 00 00 00 02 
				00 C0
				29 01 00 00 00 00 07 
				CC 00 00 00 
				00 00 00

				29 01 00 00 00 00 02 
				00 CA
				29 01 00 00 00 00 06 
				CC 00 00 00 
				00 00

				29 01 00 00 00 00 02 
				00 D0
				29 01 00 00 00 00 0c 
				CC 00 00 00 
				00 00 26 01 
				09 0b 25 00

				29 01 00 00 00 00 02 
				00 00 
				29 01 00 00 00 00 15 
				E1 00 07 10 
				22 40 56 66 
				99 88 9f 6a 
				5a 74 61 68 
				61 5b 4e 44 
				00 

				29 01 00 00 00 00 02 
				00 00 
				29 01 00 00 00 00 15 
				E2 00 07 10 
				22 40 56 66 
				99 88 9f 6a 
				5a 74 61 68 
				61 5b 4e 44 
				00 

				29 01 00 00 00 00 02 
				00 80
				29 01 00 00 00 00 02 
				C4 30	

				29 01 00 00 00 00 02 
				00 98
				29 01 00 00 00 00 02 
				C0 00	

				29 01 00 00 00 00 02 
				00 a9
				29 01 00 00 00 00 02 
				C0 06	

				29 01 00 00 00 00 02 
				00 b0
				29 01 00 00 00 00 04 
				C1 20 00 00

				29 01 00 00 00 00 02 
				00 e1
				29 01 00 00 00 00 03 
				C0 40 18

				29 01 00 00 00 00 02 
				00 80
				29 01 00 00 00 00 03 
				C1 03 33

				29 01 00 00 00 00 02 
				00 A0
				29 01 00 00 00 00 02 
				C1 e8

				29 01 00 00 00 00 02 
				00 90
				29 01 00 00 00 00 02 
				b6 b4	

				29 01 00 00 00 00 02 
				00 00
				29 01 00 00 00 00 02 
				fb 01

				29 01 00 00 00 00 02 
				00 00
				29 01 00 00 00 00 04 
				FF FF FF FF
				05 01 00 00 78 00 02 
				11 00
				05 01 00 00 32 00 02 
				29 00
			];
		qcom,mdss-dsi-off-command = [
		            05 01 00 00 78 00 02 28 00
					05 01 00 00 14 00 02 10 00];
		qcom,mdss-dsi-on-command-state = "dsi_lp_mode";
		qcom,mdss-dsi-off-command-state = "dsi_lp_mode";
		qcom,mdss-dsi-h-sync-pulse = <1>;
		qcom,mdss-dsi-traffic-mode = "burst_mode";
		qcom,mdss-dsi-lane-map = "lane_map_0123";
		qcom,mdss-dsi-bllp-eof-power-mode;
		qcom,mdss-dsi-bllp-power-mode;
		qcom,mdss-dsi-lane-0-state;
		qcom,mdss-dsi-lane-1-state;
		qcom,mdss-dsi-panel-timings = [5F 1D 15 00 2E 2D 19 1F 24 03 04 00];
		qcom,mdss-dsi-t-clk-post = <0x20>;
		qcom,mdss-dsi-t-clk-pre = <0x2E>;
		qcom,mdss-dsi-bl-min-level = <1>;
		qcom,mdss-dsi-bl-max-level = <4095>;
		qcom,mdss-dsi-bl-pmic-control-type = "bl_ctrl_pwm";
		qcom,mdss-dsi-bl-pmic-pwm-frequency = <100>;
		qcom,mdss-dsi-bl-pmic-bank-select = <0>;
		qcom,mdss-dsi-pwm-gpio = <&pm8909_mpps 2 0>;
		qcom,mdss-dsi-dma-trigger = "trigger_sw";
		qcom,mdss-dsi-mdp-trigger = "none";
		qcom,mdss-dsi-reset-sequence = <1 20>, <0 20>, <1 20>;
	};
};
