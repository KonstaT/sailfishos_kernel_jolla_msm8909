## drivers/misc/kmsgdumper/Kconfig
```kconfig
config KMSG_DUMPER
	tristate "Kmsg panic/oops dumper"
	help
		This enables panic and oops messages to be logged to a file.
```

## drivers/staging/gencrash/Kconfig
```kconfig
config GEN_CRASH
	tristate "Crash generator"
	help
		This enables crash generator.
```
